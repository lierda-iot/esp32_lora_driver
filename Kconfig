## Kconfig
```kconfig
menu "Liot LR2021 (IDF)"

choice SMTC_RADIO_FAMILY
    prompt "Radio chip family"
    default SMTC_RADIO_LR20XX

config SMTC_RADIO_SX126X
    bool "SX126x series (SX1261/SX1262)"

config SMTC_RADIO_LR11XX
    bool "LR11xx series"

config SMTC_RADIO_LR20XX
    bool "LR20xx series"

endchoice

if SMTC_RADIO_SX126X

choice SMTC_SX126X_CHIP
    prompt "SX126x chip model"
    default SMTC_RADIO_SX1262

config SMTC_RADIO_SX1261
    bool "SX1261"

config SMTC_RADIO_SX1262
    bool "SX1262"

config SMTC_RADIO_SX1268
    bool "SX1268"

endchoice

config SMTC_SX126X_ENABLE_BPSK
    bool "Enable SX126x BPSK driver"
    default n
    help
        Build the optional SX126x BPSK driver source.
        This follows the upstream SX126X_ENABLE_BPSK option.

config SMTC_SX126X_ENABLE_LR_FHSS
    bool "Enable SX126x LR-FHSS driver"
    default y
    help
        Build the optional SX126x LR-FHSS driver sources.
        Upstream RAC integration enables this for SX126x builds.

endif # SMTC_RADIO_SX126X

config LIOT_GPIO_RANGE_MIN
    int
    default -1

config LIOT_GPIO_RANGE_MAX
    int
    default 48

menu "Logging"

choice SMTC_RAC_LOG_PROFILE
    prompt "RAC business log profile"
    default SMTC_RAC_LOG_MINIMAL
    help
        Select the built-in RAC business log profile.

config SMTC_RAC_LOG_OFF
    bool "OFF"
    help
        Disable FSK, LoRa, and LR-FHSS RAC business logs.

config SMTC_RAC_LOG_MINIMAL
    bool "MINIMAL"
    help
        Enable only LoRa RAC business logs.

config SMTC_RAC_LOG_VERBOSE
    bool "VERBOSE"
    help
        Enable FSK, LoRa, and LR-FHSS RAC business logs.

config SMTC_RAC_LOG_ALL
    bool "ALL"
    help
        Currently equivalent to VERBOSE.

endchoice

endmenu

menu "Radio Planner"

config SMTC_RP_MARGIN_DELAY
    int "Radio Planner margin delay in ms"
    default 8
    range 1 100
    help
        Safety margin used by the radio planner scheduling logic.
        Increase this value if tight radio tasks miss timing on the ESP target.

choice SMTC_REGION_DUTY_CYCLE
    prompt "Region duty-cycle profile"
    default SMTC_REGION_DUTY_CYCLE_NONE
    help
        Select a duty-cycle region macro for the radio planner.
        Leave disabled when region policy is handled by the upper layer.

config SMTC_REGION_DUTY_CYCLE_NONE
    bool "Disabled"

config SMTC_REGION_EU_868
    bool "EU 868"

config SMTC_REGION_RU_864
    bool "RU 864"

endchoice

endmenu

if SMTC_RADIO_LR11XX

config SMTC_LR11XX_CRC_OVER_SPI
    bool "Enable LR11xx CRC over SPI"
    default n
    help
        Enable CRC-protected SPI transactions for LR11xx radios.
        Keep disabled unless the LR11xx hardware and firmware path requires it.

config SMTC_LR11XX_DRIVER_GEOLOCATION
    bool "Enable LR11xx geolocation driver APIs"
    default y
    help
        Build LR11xx GNSS and Wi-Fi geolocation driver sources.
        This follows the upstream LR11XX_DRIVER_GEOLOCATION option.

endif # SMTC_RADIO_LR11XX

if SMTC_RADIO_LR20XX

choice SMTC_LR20XX_CHIP
    prompt "LR20xx chip model"
    default SMTC_RADIO_LR2021

config SMTC_RADIO_LR2012
    bool "LR2012"

config SMTC_RADIO_LR2021
    bool "LR2021"

config SMTC_RADIO_LR2022
    bool "LR2022"

endchoice

choice LIERDA_LR20XX_BOARD
    prompt "Lierda LR20XX board"
    default LIERDA_BOARD_LRMAM36_FANN4

config LIERDA_BOARD_LRMWP35_FANN4
    bool "L-LRMWP35-FANN4"

config LIERDA_BOARD_LRMAM36_FANN4
    bool "L-LRMAM36-FANN4"

config LIERDA_BOARD_GENERIC
    bool "Generic / Custom LR2021 SPI board"

endchoice

config LR2021_RADIO_SPI_ID
    int "LR2021 SPI host ID"
    default 1 if LIERDA_BOARD_LRMAM36_FANN4
    default 1
    range 0 2
    help
        SPI host ID used to communicate with the LR2021 radio.
        Typical values:
          0 = SPI1 (reserved, not recommended for user devices)
          1 = SPI2 (HSPI)
          2 = SPI3 (VSPI)

        For ESP32-Cx targets, SPI2 is usually the only available
        general-purpose SPI host.

config LR2021_NRST_GPIO
    int "LR2021 NRST GPIO number" if LIERDA_BOARD_LRMWP35_FANN4 || LIERDA_BOARD_GENERIC
    default 38 if LIERDA_BOARD_LRMAM36_FANN4
    default 38
    range LIOT_GPIO_RANGE_MIN LIOT_GPIO_RANGE_MAX
    help
        GPIO number used as external reset (NRST) signal.
        This GPIO will be configured as output and driven low or high
        to reset the LR2021 radio.
        Do not select GPIOs used for flash, PSRAM, strapping, or JTAG.
        Set to -1 if NRST is not connected.

config LR2021_BUSY_GPIO
    int "LR2021 BUSY GPIO number" if LIERDA_BOARD_LRMWP35_FANN4 || LIERDA_BOARD_GENERIC
    default 17 if LIERDA_BOARD_LRMAM36_FANN4
    default 17
    range LIOT_GPIO_RANGE_MIN LIOT_GPIO_RANGE_MAX
    help
        GPIO number connected to the BUSY pin of the LR2021 radio.
        This pin is used to indicate when the radio is busy and must
        be configured as an input pin.

config LR2021_NSS_GPIO
    int "LR2021 NSS GPIO number" if LIERDA_BOARD_LRMWP35_FANN4 || LIERDA_BOARD_GENERIC
    default 39 if LIERDA_BOARD_LRMAM36_FANN4
    default 39
    range LIOT_GPIO_RANGE_MIN LIOT_GPIO_RANGE_MAX
    help
        GPIO number used as NSS (chip select) for the LR2021 radio.
        This GPIO is controlled by the SPI master driver and must be
        configured as an output pin.

config LR2021_SPI_MOSI
    int "LR2021 SPI MOSI GPIO" if LIERDA_BOARD_LRMWP35_FANN4 || LIERDA_BOARD_GENERIC
    default 41 if LIERDA_BOARD_LRMAM36_FANN4
    default 41
    range LIOT_GPIO_RANGE_MIN LIOT_GPIO_RANGE_MAX
    help
        GPIO number used for LR2021 SPI MOSI signal.

config LR2021_SPI_MISO
    int "LR2021 SPI MISO GPIO" if LIERDA_BOARD_LRMWP35_FANN4 || LIERDA_BOARD_GENERIC
    default 42 if LIERDA_BOARD_LRMAM36_FANN4
    default 42
    range LIOT_GPIO_RANGE_MIN LIOT_GPIO_RANGE_MAX
    help
        GPIO number used for LR2021 SPI MISO signal.

config LR2021_SPI_CLK
    int "LR2021 SPI SCLK GPIO" if LIERDA_BOARD_LRMWP35_FANN4 || LIERDA_BOARD_GENERIC
    default 40 if LIERDA_BOARD_LRMAM36_FANN4
    default 40
    range LIOT_GPIO_RANGE_MIN LIOT_GPIO_RANGE_MAX
    help
        GPIO number used for LR2021 SPI clock signal.

menu "LR20XX DIO Configuration"
    visible if LIERDA_BOARD_LRMWP35_FANN4 || LIERDA_BOARD_GENERIC

config LR20XX_DIO7_GPIO
    int "LR20XX DIO7 GPIO number" if LIERDA_BOARD_LRMWP35_FANN4 || LIERDA_BOARD_GENERIC
    default 21 if LIERDA_BOARD_LRMAM36_FANN4
    default 21
    range LIOT_GPIO_RANGE_MIN LIOT_GPIO_RANGE_MAX
    help
        GPIO number connected to LR20XX DIO7 pin.
        Valid only when LR20XX radio family is selected.

endmenu

endif # SMTC_RADIO_LR20XX

endmenu
```
